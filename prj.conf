## CMakeLists.txt
```
cmake_minimum_required(VERSION 3.13.1)

set(NRF_SUPPORTED_BOARDS
	nrf5340pdk_nrf5340_cpuapp
	# nrf52dk_nrf52832
	# nrf52840dk_nrf52840
)

find_package(Zephyr REQUIRED HINTS $ENV{ZEPHYR_BASE})
project(nrf_ble_rolling_shutter_poc)

FILE(GLOB app_sources src/*.c)
target_sources(app PRIVATE
	${app_sources}
)
```

## prj.conf
```kconfig
CONFIG_BT=y
CONFIG_BT_DEBUG_LOG=y
CONFIG_BT_MAX_CONN=4
CONFIG_BT_MAX_PAIRED=4
# CONFIG_BT_SMP=y
CONFIG_BT_L2CAP_TX_BUF_COUNT=5
CONFIG_BT_PERIPHERAL=y
CONFIG_BT_DEVICE_NAME="RollingShutter_POC"
CONFIG_BT_DEVICE_APPEARANCE=384

CONFIG_BT_LL_SOFTDEVICE_DEFAULT=y

CONFIG_HEAP_MEM_POOL_SIZE=2048

CONFIG_SYSTEM_WORKQUEUE_STACK_SIZE=2048

CONFIG_NRFX_TIMER1=y
```

## src/main.c
```c
#include <zephyr.h>
#include <sys/printk.h>
#include <sys/byteorder.h>
#include <errno.h>
#include <drivers/gpio.h>

#include <bluetooth/bluetooth.h>
#include <bluetooth/hci.h>
#include <bluetooth/conn.h>
#include <bluetooth/uuid.h>
#include <bluetooth/gatt.h>

#include "rf.h"
#include "kitchen.h"


#define DEVICE_NAME CONFIG_BT_DEVICE_NAME
#define DEVICE_NAME_LEN (sizeof(DEVICE_NAME) - 1)

static K_SEM_DEFINE(ble_init_ok, 0, 1);
static const struct bt_data ad[] = {
    BT_DATA_BYTES(BT_DATA_FLAGS, (BT_LE_AD_GENERAL | BT_LE_AD_NO_BREDR)),
    BT_DATA(BT_DATA_NAME_COMPLETE, DEVICE_NAME, DEVICE_NAME_LEN)
};
static const struct bt_data sd[] = {
    BT_DATA_BYTES(BT_DATA_UUID128_ALL, KITCHEN_SERVICE_UUID)
};

static struct k_work adv_work;

static void error(void) {
    for (;;) {
        printk("Unexpected Error\n");
        k_sleep(K_MSEC(1000));
    }
}

static void adv_continue(void) {
	struct bt_le_adv_param adv_param;

    int err;

    adv_param = *BT_LE_ADV_CONN;
    adv_param.options |= BT_LE_ADV_OPT_ONE_TIME;
    err = bt_le_adv_start(&adv_param, ad, ARRAY_SIZE(ad),
                sd, ARRAY_SIZE(sd));
    if (err) {
        printk("Advertising failed to start (err %d)\n", err);
        return;
    }

    printk("Regular advertising started\n");
}

static void adv_start(void) {
    k_work_submit(&adv_work);
}

static void adv_handler(struct k_work *work) {
    adv_continue();
}

static void bt_connected(struct bt_conn *conn, uint8_t err) {
    struct bt_conn_info info;
    char addr[BT_ADDR_LE_STR_LEN];

    if (err) {
        printk("BLE connection failed: err=%d\n", err);
        return;
    }

    if (bt_conn_get_info(conn, &info)) {
        printk("BLE could not parse connection info\n");
    } else {
        bt_addr_le_to_str(bt_conn_get_dst(conn), addr, sizeof(addr));

        printk("Connection established!\n\
        Connected to: %sn\n\
        Role: %u\n\
        Connection interval: %u\n\
        Slave latency: %u\n\
        Connection supervisory timeout: %u\n", addr, info.role, info.le.interval, info.le.latency, info.le.timeout);

        adv_start();
    }
}

static void bt_disconnected(struct bt_conn *conn, uint8_t reason) {
    printk("BLE disconnected (reason: %d)\n", reason);

    adv_start();
}

static bool bt_le_param_req(struct bt_conn *conn, struct bt_le_conn_param *param) {
    return true;
}

static void bt_le_param_updated(struct bt_conn *conn, uint16_t interval, uint16_t latency, uint16_t timeout) {
    struct bt_conn_info info;
    char addr[BT_ADDR_LE_STR_LEN];

    if (bt_conn_get_info(conn, &info)) {
        printk("BLE could not parse connection info\n");
    } else {
        bt_addr_le_to_str(bt_conn_get_dst(conn), addr, sizeof(addr));

        printk("BT connection parameters updated!\n\
        Connected to: %s\n\
        New connection interval: %u\n\
        New slave latency: %u\n\
        New connection supervisory timeout: %u\n", addr, info.le.interval, info.le.latency, info.le.timeout);
    }
}

static struct bt_conn_cb bt_conn_callbacks = {
    .connected = bt_connected,
    .disconnected = bt_disconnected,
    .le_param_req = bt_le_param_req,
    .le_param_updated = bt_le_param_updated
};

static void bt_ready(int err) {
    if (err) {
        printk("BLE init failed with error code: %d\n", err);
        return;
    }

    bt_conn_cb_register(&bt_conn_callbacks);

    adv_start();

    k_sem_give(&ble_init_ok);
}

void main(void) {
    int err = 0;

    printk("Starting nRF BLE Rolling Shutter controll POC\n");

    k_work_init(&adv_work, adv_handler);
    err = bt_enable(bt_ready);
    if (err != 0) {
        printk("BLE initialization failed\n");
        error();
    }
    err = k_sem_take(&ble_init_ok, K_MSEC(500));
    if (!err) {
        printk("BLE initialized\n");
    } else {
        printk("BLE initialization did not complete in time\n");
        error();
    }

    rf_init();

    err = kitchen_service_init();
    if (err != 0) {
        printk("Unable to initilize Kitchen BT service");
    }
}
```

## src/kitchen.c
```c
#include "kitchen.h"


#define MAX_TRANSMIT_SIZE 240

#define BT_UUID_KITCHEN_SERVICE    BT_UUID_DECLARE_128(KITCHEN_SERVICE_UUID)
#define BT_UUID_KITCHEN_SERVICE_RX BT_UUID_DECLARE_128(KITCHEN_SERVICE_RX_CHARACTERISTIC_UUID)


uint8_t data_rx[MAX_TRANSMIT_SIZE];

static ssize_t on_receive(struct bt_conn *conn, const struct bt_gatt_attr *attr, const void *buf, uint16_t len, uint16_t offset, uint8_t flags);
void on_cccd_changed(const struct bt_gatt_attr *attr, uint16_t value);

BT_GATT_SERVICE_DEFINE(
    kitchen_service,
    BT_GATT_PRIMARY_SERVICE(BT_UUID_KITCHEN_SERVICE),
    BT_GATT_CHARACTERISTIC(
        BT_UUID_KITCHEN_SERVICE_RX,
        BT_GATT_CHRC_WRITE | BT_GATT_CHRC_WRITE_WITHOUT_RESP,
        BT_GATT_PERM_READ | BT_GATT_PERM_WRITE,
        NULL, on_receive, NULL
    ),
    BT_GATT_CCC(on_cccd_changed, BT_GATT_PERM_READ | BT_GATT_PERM_WRITE),
);

int kitchen_service_init(void) {
    int err = 0;

    memcpy(&data_rx, 0, MAX_TRANSMIT_SIZE);

    return err;
}

static ssize_t on_receive(struct bt_conn *conn, const struct bt_gatt_attr *attr, const void *buf, uint16_t len, uint16_t offset, uint8_t flags) {
    const uint8_t *buffer = buf;

    printk("Receive data, handle %d, conn %p, data: 0x", attr->handle, conn);
    for (uint8_t i=0; i<len; i++) {
        printk("%02X", buffer[i]);
    }
    printk("\n");

    if (len == 1) {
        rf_set_cmd(buffer[0]);
        rf_start_send();
    }

    return len;
}

void on_cccd_changed(const struct bt_gatt_attr *attr, uint16_t value) {
    ARG_UNUSED(attr);

    switch (value) {
    case BT_GATT_CCC_NOTIFY:
        break;
    case BT_GATT_CCC_INDICATE:
        break;
    case 0:
        break;
    
    default:
        printk("Error, CCCD has been set to an invalid value");
        break;
    }
}
```

## src/kitchen.h
```c
#ifndef __KITCHEN_H__
#define __KITCHEN_H__

#include <zephyr.h>
#include <zephyr/types.h>
#include <sys/printk.h>
#include <sys/byteorder.h>
#include <errno.h>
#include <string.h>

#include <bluetooth/bluetooth.h>
#include <bluetooth/hci.h>
#include <bluetooth/conn.h>
#include <bluetooth/addr.h>
#include <bluetooth/uuid.h>
#include <bluetooth/gatt.h>

#include "rf.h"


#define KITCHEN_SERVICE_UUID 0x4e, 0x2f, 0xb7, 0xad, 0x24, 0x08, 0x5d, 0x20, 0xb5, 0x51, 0xe3, 0xb3, 0xb2, 0x37, 0x3e, 0x3b
#define KITCHEN_SERVICE_RX_CHARACTERISTIC_UUID 0x3b, 0x00, 0x03, 0x30, 0xda, 0x0c, 0x57, 0xb9, 0x8d, 0x26, 0x03, 0xb0, 0xc1, 0x85, 0xea, 0xc7

int kitchen_service_init(void);

#endif
```

## src/rf.c
```c
#include "rf.h"


#define RF_GPIO_PIN 26


static struct rf_cmd_t rf_cmd;
static const struct device *gpio0_dev;
static const nrfx_timer_t rf_timer = NRFX_TIMER_INSTANCE(1);

void rf_start_send(void) {
    nrfx_timer_disable(&rf_timer);
	nrf_timer_shorts_disable(rf_timer.p_reg, ~0);
	nrf_timer_int_disable(rf_timer.p_reg, ~0);

	nrfx_timer_extended_compare(
		&rf_timer,
		NRF_TIMER_CC_CHANNEL0,
		nrfx_timer_us_to_ticks(&rf_timer, 360),
		NRF_TIMER_SHORT_COMPARE0_CLEAR_MASK,
		true
	);
	nrfx_timer_clear(&rf_timer);
	nrfx_timer_enable(&rf_timer);
}

static void rf_timer_handler(nrf_timer_event_t event_type, void *context) {
	struct rf_cmd_t *cmd = (struct rf_cmd_t *) context;

	if (event_type == NRF_TIMER_EVENT_COMPARE0) {
        if (cmd->resend_pause != 0) {
            cmd->resend_pause--;
            return;
        }

		if (cmd->cur_bit == 8) {
			cmd->cur_bit = 0;
			cmd->cur_byte++;
			if (cmd->cur_byte <= cmd->seq_len) {
			}
		}
		if (cmd->cur_byte > cmd->seq_len) {
			printk("\nSent\n");
			gpio_pin_set(gpio0_dev, RF_GPIO_PIN, 0);

            if (cmd->resend != 0) {
                cmd->resend--;
                cmd->resend_pause = 4;
                cmd->cur_bit = 0;
	            cmd->cur_byte = 0;
            } else {
                nrfx_timer_disable(&rf_timer);
			    return;
            }
		}

		uint8_t bt = (cmd->seq[cmd->cur_byte] >> (7 - cmd->cur_bit)) & 1;
		gpio_pin_set(gpio0_dev, RF_GPIO_PIN, bt);

		cmd->cur_bit++;

	}
}

int rf_timer_init(struct rf_cmd_t *cmd) {
    nrfx_err_t err;
	nrfx_timer_config_t timer_cfg = {
		.frequency = NRF_TIMER_FREQ_16MHz,
		.mode = NRF_TIMER_MODE_TIMER,
		.bit_width = NRF_TIMER_BIT_WIDTH_32,
		.p_context = (void *) cmd,
	};

	err = nrfx_timer_init(&rf_timer, &timer_cfg, rf_timer_handler);
	if (err != NRFX_SUCCESS) {
		printk("nrfx_timer_init failed with: %d\n", err);
	}

    return err;
}

int rf_init(void) {
    int err = 0;

    gpio0_dev = device_get_binding("GPIO_0");
	if (gpio0_dev == NULL) {
		printk("Error: could not find device GPIO_0\n");
		return -1;
	}
	err = gpio_pin_configure(gpio0_dev, RF_GPIO_PIN, GPIO_OUTPUT);
	if (err != 0) {
		printk("Error %d: failed to configure GPIO_0 pin %d\n", err, RF_GPIO_PIN);
		return err;
	}

    rf_timer_init(&rf_cmd);
    IRQ_CONNECT(TIMER1_IRQn, NRFX_TIMER_DEFAULT_CONFIG_IRQ_PRIORITY, nrfx_timer_1_irq_handler, NULL, 0);

    return 0;
}

void rf_set_cmd(uint8_t cmd_code) {
    rf_cmd.seq_len = 17;
	rf_cmd.cur_bit = 0;
	rf_cmd.cur_byte = 0;
    rf_cmd.resend = 10;

    uint8_t seq[][17] = {
        // ... fill with your codes
    };

    if (cmd_code < 12) {
        memcpy(rf_cmd.seq, seq[cmd_code], rf_cmd.seq_len);
    }
}
```

## src/rf.h
```c
#ifndef __RF_H__
#define __RF_H__

#include <zephyr.h>
#include <sys/printk.h>
#include <device.h>
#include <drivers/gpio.h>
#include <nrfx_timer.h>
#include <string.h>

struct rf_cmd_t {
    uint8_t seq[32];
    uint8_t seq_len;
    uint8_t cur_byte;
    uint8_t cur_bit;
    uint8_t resend;
    uint8_t resend_pause;
};

int  rf_init(void);
void rf_start_send(void);
void rf_set_cmd(uint8_t cmd_code);

#endif
```
